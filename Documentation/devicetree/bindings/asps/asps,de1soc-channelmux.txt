## Documentation/devicetree/bindings/asps/asps,de1soc-channelmux.txt
```
Channel Multiplexer bindings for Altera's SoCFPGA platform

Required properties:
- compatible : shall be one of the following:
"asps,de1soc-channelmux" - for the audio source data multiplexer
```

## Documentation/devicetree/bindings/asps/asps,de1soc-datasourcemux.txt
```
Data Source Multiplexer bindings for Altera's SoCFPGA platform

Required properties:
- compatible : shall be one of the following:
"asps,de1soc-datasourcemux" - for the audio source data multiplexer
```
